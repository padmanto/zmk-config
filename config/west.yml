## config/west.yml
```yaml
manifest:
  remotes:
    - name: zmkfirmware
      url-base: https://github.com/zmkfirmware
    - name: krikun98
      url-base: https://github.com/krikun98
    - name: urob
      url-base: https://github.com/urob/zmk
  projects:
    - name: zmk
      #remote: krikun98
      #revision: mouse-pr 
      remote: urob
      revision: main 
      import: app/west.yml
  self:
    path: config
```
